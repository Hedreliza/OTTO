#include "RFID.h"

const CARTAO listaCartao[] PROGMEM = {
    {{0x03, 0x98, 0xA3, 0xAA}, 0 }, // A-Avião
    {{0x83, 0xBD, 0x0D, 0x0E}, 0 }, // B-Bola
    {{0xC3, 0x28, 0x19, 0x11}, 0 }, // C-Carro
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    {{0x83, 0x5B, 0x80, 0x94}, 96 },  // Obrigado

    };

MFRC522 mfrc522(PIN_RFID_SS, PIN_RFID_RST);  

const int TOTAL_CARTOES = sizeof(listaCartao) / sizeof(CARTAO);

const CARTAO_ANIMADO CATALOGO_CARTAO_ANIMADO[] PROGMEM = {
  {83, Face_Sorriso, aceno},
  /*{ 84, Face_Raiva,},
  { 85, Face_Triste, },
  { 87, Face_Medo, },
  { 88, Face_Sono0, },
  { 89, Face_Sono1, },
  { 90, Face_Cansado, },
*/
};

const int QUANTIDADE_CARTOESANIMADOS = 
  sizeof(CATALOGO_CARTAO_ANIMADO) / sizeof(CATALOGO_CARTAO_ANIMADO[0]);

void configurarRFID(){
    SPI.begin();
    mfrc522.PCD_Init();
}

void verificarRFID(){
    byte status = mfrc522.PCD_ReadRegister(mfrc522.VersionReg);
    if(status == 0x00 || status == 0xFF){
        otto.RFID = RFID_ERRO;
    } else {
        otto.RFID = RFID_OK;
    }
}

int buscarAudioCartao(){ 
    for(int pos = 0; pos < TOTAL_CARTOES; pos++){      
        bool igual = true;

        for(int byte = 0; byte < tamanhoByteUIDCartao; byte++){
            // Lê um byte da memória Flash e compara com o byte lido do cartão
            if(pgm_read_byte(&listaCartao[pos].uid[byte]) != mfrc522.uid.uidByte[byte]){
                igual = false;
                break;
            }
        }
        
        if(igual){
            return (int)pgm_read_word(&listaCartao[pos].numeroAudio);          
        }       
    }
    return -1; 
}

void executarLeituraCartaoAnimado(int numeroAudio){

    for (int indice = 0; indice < QUANTIDADE_CARTOESANIMADOS; indice++){

        if (CATALOGO_CARTAO_ANIMADO[indice].idAudio == numeroAudio){
            
            const byte* face = (const byte*)pgm_read_ptr(&CATALOGO_CARTAO_ANIMADO[indice].face);
            const Coreografia* coreografiaCartao = (const Coreografia*)pgm_read_ptr(&CATALOGO_CARTAO_ANIMADO[indice].coreografia);
            int totalPassos = pgm_read_word(&CATALOGO_CARTAO_ANIMADO[indice].totalPassos);
            
            mostrar(face);
            solicitarCoreografia(coreografiaCartao,totalPassos);
        }
    }

}

void LeituraCartaoRFID(){

    unsigned long t = micros();
    if (!mfrc522.PICC_IsNewCardPresent()) {
        Serial.print(F("RFID (sem cartao): "));
        Serial.print(micros() - t);
        Serial.println(F(" us"));
        return;
    }
     
    if (!mfrc522.PICC_ReadCardSerial()) {
        return;
    }

    Serial.println(F(">>> CARTAO DETECTADO")); 
    int audio = buscarAudioCartao();
    
    if(audio != -1){
        tocarAudio(audio);
        if((audio >= faixaAnimacaoInicio) && (audio <= faixaAnimacaoFim)){
            executarLeituraCartaoAnimado(audio);
        }

        Serial.print(F("-> SUCESSO! Tocando audio "));
        Serial.println(audio);
        
    } else {
        Serial.println(F("-> FALHA: Cartao NAO cadastrado na lista!"));
    }
    
    mfrc522.PICC_HaltA();
    mfrc522.PCD_StopCrypto1();
    
}

